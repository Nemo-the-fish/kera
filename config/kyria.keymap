/*
 * Copyright (c) 2020 The ZMK Contributors
 *
 * SPDX-License-Identifier: MIT
 */

#include <behaviors.dtsi>
#include <dt-bindings/zmk/keys.h>

/ {
	keymap {
		compatible = "zmk,keymap";

		default_layer {
// ---------------------------------------------------------------------------------------------------------------------------------
// |  ESC  |  Q  |  W  |  E   |  R   |  T   |                                          |  Y   |  U    |  I    |  O   |   P   |   \  |
// |  TAB  |  A  |  S  |  D   |  F   |  G   |                                          |  H   |  J    |  K    |  L   |   ;   |   '  |
// | SHIFT |  Z  |  X  |  C   |  V   |  B   | L SHIFT | L SHIFT |  | L SHIFT | L SHIFT |  N   |  M    |  ,    |  .   |   /   | GUI |
//                     | LALT  | CTRL  | RET  |  SPACE  |   ESC   |  |   RET   |  SePACE  | TAB  | BSPC  | R-ALT |
			bindings = <
	&kp ESC   &kp Q &kp W &kp E &kp R &kp T                                                &kp Y &kp U  &kp I    &kp O   &kp P    &kp BSLH
	&kp TAB   &kp A &kp S &kp D &kp F &kp G                                                &kp H &kp J  &kp   K   &kp L   &kp SEMI &kp SQT
	&kp LSHFT &kp Z &kp X &kp C &kp V &kp B &kp FKEY &kp LSHFT        &kp LSHFT &mo BT &kp N &kp M  &kp COMMA &kp DOT &kp FSLH &kp RGUI
	                 &kp LALT &kp LCTRL &mo NUM &kp SPACE &kp LSHFT      &kp LSHFT  &kp BSPC  &mo NUM &kp RET &kp RALT
			>;

			sensor-bindings = <&inc_dec_kp C_VOL_UP C_VOL_DN &inc_dec_kp PG_UP PG_DN>;
		};
	};
	
	NUM_layer {
            bindings = <
        &kp ESC   &kp 7 &kp 8 &kp 9 &kp ( &kp )                                                &none &none       &none    &none      &none &kp BSLH
	&kp TAB   &kp 4 &kp 5 &kp 6 &kp - &kp \                                                &none &none      &kp up    &none      &none &kp SQT
	&kp LSHFT &kp 1 &kp 2 &kp 3 &kp [ &kp ] &kp LSHFT &kp LSHFT        &kp LSHFT &kp LSHFT &none  &kp left  &kp down  &kp right  &none  &kp RCTRL
	                 &kp LALT &kp LCTRL &none &kp SPACE &kp ESC        &kp RET  &kp SPACE  &kp TAB &kp BSPC &kp RALT
			 
            		>;
       		 };
	};
	FKEY_layer {
            bindings = <
        &kp ESC   &kp F7 &kp F8 &kp F9 &none &none                                                &kp Y &kp U  &kp I     &kp O   &kp P    &kp BSLH
	&kp TAB   &kp F4 &kp F5 &kp F6 &none &none                                                &kp H &kp J  &kp K     &kp L   &kp SEMI &kp SQT
	&kp LSHFT &kp F1 &kp F2 &kp F3 &none &none &none &kp LSHFT        &kp LSHFT &kp LSHFT &kp N &kp M  &kp COMMA &kp DOT &kp FSLH &kp RCTRL
	                 &kp LALT &kp LCTRL &none &kp SPACE &kp ESC        &kp RET  &kp SPACE  &kp TAB &kp BSPC &kp RALT
			 
            		>;
       		 };
	};
	BT_layer {
            bindings = <
        &none &none &none &none &none &none                                            &none &none       &none &none &none &none
	&none &none &none &none &none &none                                           &none &bt BT_SEL 0   &bt BT_SEL 1 &bt BT_SEL 2 &bt BT_SEL 3 &bt BT_SEL 4
	&none &none &none &none &none &none     &none &none        &none &none        &none &bt BT_CLR  &none &none &none &none
	                     &none &none &none &none &none         &none &none   &none &none &none
			 
            		>;
       		 };
	};
};
